## arch/arm/mach-msm/cust/Kconfig
```kconfig
if CUST_PANTECH_H

#
# PANTECH Cust feature section
#

config PANTECH_ATNT
     bool

if MACH_MSM8960_MAGNUS
config DEFINE_LIST_MAGNUS
	bool
	default y
	select PANTECH_ATNT
	select PANTECH_ERR_CRASH_LOGGING
	select PANTECH_PMIC
	select PANTECH_PMIC_PWRKEY
	select PANTECH_PMIC_RESET_REASON
	select PANTECH_BMS
	select PANTECH_CHARGER
	select PANTECH_PMIC_MAX17058
	select PANTECH_FS_AUTO_REPAIR
	select F_SKYDISP_SILENT_BOOT
	select F_SKYDISP_QBUG_FIX_BACKLIGHT
	select F_SKYDISP_CONT_SPLASH_DISP
	select F_SKYDISP_BOOT_LOGO_IN_KERNEL
	select F_SKYDISP_FORCE_ENCRYPTION_OFF
	select F_SKYDISP_CABC_FIX
	select F_SKYDISP_NO_CURSOR_IN_BOOT
	select F_SKYDISP_LCD_RESET
	select F_SKYDISP_LCD_FORCE_ONOFF
	select F_SKYDISP_LCD_DMA_TIMEOUT
	select PANTECH_LCD_POWEROFFSEQ_ON_PHONEOFF
	select PANTECH_SDCARD_HIGH_VOLTAGE_FIX
	select ANDROID_PANTECH_USB_ABNORMAL_CHARGER_INFO
	select PANTECH_MMC
endif

config PANTECH_ERR_CRASH_LOGGING
	bool

config PANTECH_SDCARD_HIGH_VOLTAGE_FIX
	bool

config PANTECH_FS_AUTO_REPAIR
	bool

config PANTECH_PMIC
	bool

config PANTECH_PMIC_PWRKEY
	bool

config PANTECH_PMIC_MAX17058
	bool
	
config PANTECH_PMIC_RESET_REASON
	bool
	
config PANTECH_BMS
	bool
	select PANTECH_BMS_UPDATE
	select PANTECH_BMS_BATTERY_TYPE
	select PANTECH_BMS_TEST
config PANTECH_BMS_UPDATE
	bool
config PANTECH_BMS_BATTERY_TYPE
	bool	
config PANTECH_BMS_TEST
	bool
	
config PANTECH_CHARGER
	bool
	select PANTECH_CHARGER_OFFLINE
config PANTECH_CHARGER_OFFLINE
	bool

comment "PANTECH USB Driver"
config ANDROID_PANTECH_USB
  bool "PANTECH USB"
  default y
  help
     Support Pantech USB

config ANDROID_PANTECH_USB_MANAGER
  depends on ANDROID_PANTECH_USB
  bool "PANTECH USB Manager"
  default y
  help
     Support Pantech USB Manager

config ANDROID_PANTECH_USB_FACTORY_CABLE
  depends on ANDROID_PANTECH_USB
  bool "PANTECH USB FACTORY CABLE"
  default y
  help
     Support Pantech USB

config ANDROID_PANTECH_USB_ABNORMAL_CHARGER_INFO
 depends on ANDROID_PANTECH_USB
  bool "PANTECH USB Charger cable abnormal case"
  default n
  help
     Support Pantech USB

# LCD 
config F_SKYDISP_QBUG_FIX_BACKLIGHT
     bool 

config F_SKYDISP_BOOT_LOGO_IN_KERNEL
     bool 

config F_SKYDISP_NO_CURSOR_IN_BOOT
     bool 
        
config F_SKYDISP_CONT_SPLASH_DISP
	bool
	
config F_SKYDISP_CABC_FIX
	bool    
        
config F_SKYDISP_LCD_RESET
     bool 

config F_SKYDISP_LCD_FORCE_ONOFF
     bool 
        
config F_SKYDISP_FORCE_ENCRYPTION_OFF
     bool 

config F_SKYDISP_SILENT_BOOT
	bool

config F_SKYDISP_LCD_DMA_TIMEOUT
	bool

config PANTECH_LCD_POWEROFFSEQ_ON_PHONEOFF
	bool
	
config PANTECH_MMC
	bool

# PANTECH SOUND
config PANTECH_SND
    bool "PANTECH SOUND CONFIGS"
    default y
    help
       Support Pantech Sound configs

config PANTECH_GPIO_SLEEP_CONFIG
       bool "PANTECH GPIO SLEEP CONFIG"
       default y

endif
```
